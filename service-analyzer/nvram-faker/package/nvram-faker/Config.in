## service-analyzer/nvram-faker/package/nvram-faker/Config.in
```kconfig
config BR2_PACKAGE_NVRAM_FAKER
	bool "nvram-faker"
	help
	  nvram-faker is a library that provides a fake NVRAM
```

## service-analyzer/nvram-faker/package/nvram-fuzz/Config.in
```kconfig
config BR2_PACKAGE_NVRAM_FUZZ
	bool "nvram-fuzz"
	help
	  nvram-fuzz is a library that provides a fake NVRAM for HouseFuzz
```
